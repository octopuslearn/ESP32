## idf_esp_32/project/test_1.0/main/Kconfig.projbuild
```kconfig
menu "点灯配置"

    config LED_GPIO_NUM
        int 
        prompt "ESP主板上连接到的LE的引脚"
        range 0 39
        default 2
        help 
            一般来说这个LEDGPIO号码会写在板子的正面或背面

    config DELAY_TIME_MS
        int 
        prompt "闪烁时间"
        range 100 5000
        default 100
        help 
            闪烁时间 毫秒
        


endmenu
```
